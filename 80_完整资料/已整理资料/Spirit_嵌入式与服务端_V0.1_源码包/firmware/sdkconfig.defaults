## 80_完整资料/已整理资料/Spirit_嵌入式与服务端_V0.1_源码包/firmware/sdkconfig.defaults
```kconfig
CONFIG_IDF_TARGET="esp32s3"
CONFIG_IDF_TARGET_ESP32S3=y

CONFIG_ESPTOOLPY_FLASHMODE_QIO=y
CONFIG_ESPTOOLPY_FLASHFREQ_80M=y
CONFIG_ESPTOOLPY_FLASHSIZE_16MB=y
CONFIG_ESPTOOLPY_FLASHSIZE="16MB"

CONFIG_PARTITION_TABLE_CUSTOM=y
CONFIG_PARTITION_TABLE_CUSTOM_FILENAME="partitions.csv"
CONFIG_PARTITION_TABLE_FILENAME="partitions.csv"
CONFIG_PARTITION_TABLE_OFFSET=0x8000
CONFIG_PARTITION_TABLE_MD5=y

CONFIG_SPIRAM=y
CONFIG_SPIRAM_MODE_OCT=y
CONFIG_SPIRAM_TYPE_ESPPSRAM64=y
CONFIG_SPIRAM_SPEED_80M=y
CONFIG_SPIRAM_USE_MALLOC=y
CONFIG_SPIRAM_BOOT_INIT=y
CONFIG_SPIRAM_MEMTEST=n
CONFIG_SPIRAM_MALLOC_ALWAYSINTERNAL=2048
CONFIG_SPIRAM_MALLOC_RESERVE_INTERNAL=98304
CONFIG_SPIRAM_TRY_ALLOCATE_WIFI_LWIP=y

CONFIG_ESP_WIFI_STATIC_RX_BUFFER_NUM=3
CONFIG_ESP_WIFI_DYNAMIC_RX_BUFFER_NUM=6
CONFIG_ESP_WIFI_RX_BA_WIN=3
CONFIG_LWIP_TCPIP_RECVMBOX_SIZE=16
CONFIG_MBEDTLS_EXTERNAL_MEM_ALLOC=y
CONFIG_MBEDTLS_DYNAMIC_FREE_CONFIG_DATA=y
CONFIG_ESP_SYSTEM_EVENT_TASK_STACK_SIZE=4096
CONFIG_ESP_MAIN_TASK_STACK_SIZE=8192

CONFIG_LV_CONF_SKIP=y
CONFIG_LV_COLOR_DEPTH_16=y
CONFIG_LV_COLOR_DEPTH=16
CONFIG_LV_MEM_SIZE_KILOBYTES=32

# CONFIG_USAKI_USE_AFE_AUDIO_PROCESSOR is not set

CONFIG_MBEDTLS_CERTIFICATE_BUNDLE=y
```

## 80_完整资料/已整理资料/Spirit_嵌入式与服务端_V0.1_源码包/firmware/src/Kconfig
```kconfig
menu "Spirit v0.1 configuration"
config SPIRIT_WIFI_SSID
    string "Wi-Fi SSID (empty disables networking)"
    default ""
config SPIRIT_WIFI_PASSWORD
    string "Wi-Fi password"
    default ""
config SPIRIT_DEVICE_ID
    string "Unique device ID"
    default "spirit-dev-001"
config SPIRIT_CONNECT_URL
    string "Server device connect URL"
    default "http://example.invalid/api/v1/device/connect"
config SPIRIT_EFFECT_URL
    string "Spirit telemetry/effect WebSocket URL"
    default "ws://example.invalid/api/v1/spirit/device"
config SPIRIT_VOICE_URL
    string "Server voice WebSocket URL"
    default "ws://example.invalid/api/v1/voice/voice"
endmenu

menu "Usaki voice"

config USAKI_USE_AFE_AUDIO_PROCESSOR
    bool "Use ESP-SR AFE audio processor"
    default n
    help
        Enable the ESP-SR AFE based audio processor for device-side VAD/NS/AEC.
        This requires the esp-sr component and speech models in the model
        partition. Leave disabled to use the NoAudioProcessor pass-through path.

config USAKI_ENABLE_WAKE_WORD
    bool "Enable wake word detection"
    default n
    help
        Enable AudioService wake word detection. The default build uses a
        disabled placeholder; ESP-SR WakeNet/AFE wake word implementations
        can be selected after model assets and partitions are configured.

config USAKI_WAKE_WORD_USE_AFE
    bool "Use ESP-SR AFE WakeNet wake word"
    depends on USAKI_ENABLE_WAKE_WORD
    select USAKI_USE_AFE_AUDIO_PROCESSOR
    default n
    help
        Use the ESP-SR AFE WakeNet path migrated from Xiaozhi. This requires
        esp-sr and WakeNet models in the model partition.

config USAKI_WAKE_WORD_MODEL_NAME
    string "Preferred WakeNet model name"
    depends on USAKI_WAKE_WORD_USE_AFE
    default ""
    help
        Optional preferred WakeNet model name. Leave empty to select the first
        available ESP_WN_PREFIX model from the model partition.

endmenu
```
